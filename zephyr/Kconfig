## zephyr/Kconfig
```kconfig
source "Kconfig.zephyr"

config DAC63204
  bool "Enable DAC63204 with I2C interface"
  default n
```

## zephyr/boards/arm/zephyr_template_board/Kconfig.board
```kconfig
# Copyright (c) 2024 Technaid SL
# SPDX-License-Identifier: EUPL-1.2

config BOARD_ZEPHYR_TEMPLATE_BOARD
    bool "Zephyr Template Board"
    depends on SOC_STM32F103XB
```

## zephyr/boards/arm/zephyr_template_board/Kconfig.defconfig
```kconfig
# Copyright (c) 2024 Technaid SL
# SPDX-License-Identifier: EUPL-1.2

if BOARD_ZEPHYR_TEMPLATE_BOARD

config BOARD
    default "zephyr_template_board"

endif # BOARD_ZEPHYR_TEMPLATE_BOARD
```

## zephyr/boards/arm/zephyr_template_board/zephyr_template_board_defconfig
```kconfig
# Copyright (c) 2024 Technaid SL
# SPDX-License-Identifier: EUPL-1.2

CONFIG_SOC_SERIES_STM32F1X=y
CONFIG_SOC_STM32F103XB=y
CONFIG_BOARD_ZEPHYR_TEMPLATE_BOARD=y

# enable uart driver
CONFIG_SERIAL=y

# enable console
CONFIG_CONSOLE=y
CONFIG_UART_CONSOLE=y

# enable GPIO
CONFIG_GPIO=y

# enable clock control
CONFIG_CLOCK_CONTROL=y

# enable pin controller
CONFIG_PINCTRL=y
```
